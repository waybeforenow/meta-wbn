## conf/layer.conf
```bitbake
# We have a conf and classes directory, add to BBPATH
BBPATH .= ":${LAYERDIR}"

# We have recipes-* directories, add to BBFILES
BBFILES += "${LAYERDIR}/recipes-*/*/*.bb \
            ${LAYERDIR}/recipes-*/*/*.bbappend"

BBFILE_COLLECTIONS += "meta-wbn"
BBFILE_PATTERN_meta-wbn = "^${LAYERDIR}/"
BBFILE_PRIORITY_meta-wbn = "6"

LAYERDEPENDS_meta-wbn = "core"
LAYERSERIES_COMPAT_meta-wbn = "sumo"
```
